## config/west.yml
```yaml
manifest:
  remotes:
    - name: r0ckl0bsta
      url-base: https://github.com/r0ckl0bsta
  projects:
    - name: zmk
      remote: r0ckl0bsta
      revision: main
      import: app/west.yml
  self:
    path: config
```
